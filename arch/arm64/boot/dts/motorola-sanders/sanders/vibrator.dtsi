&pmi_haptic {
	qcom,vmax-mv = <1950>;
	qcom,wave-play-rate-us = <4255>;
	qcom,actuator-type = <1>;
	qcom,wave-shape = "sine";
	qcom,lra-auto-res-mode="none";
	qcom,lra-high-z="none";
	qcom,lra-res-cal-period = <4>;
	qcom,correct-lra-drive-freq;
	qcom,misc-trim-error-rc19p2-clk-reg-present;
	qcom,brake-pattern = [03 03 03 03];
};
